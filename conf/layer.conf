## conf/layer.conf
```bitbake
# We might have a conf and classes directory, append to BBPATH
BBPATH .= ":${LAYERDIR}"

# We have a recipes directory, add to BBFILES
BBFILES += "${LAYERDIR}/recipes*/*/*.bb ${LAYERDIR}/recipes*/*/*.bbappend"

BBFILE_COLLECTIONS += "meta-kirkwood"
BBFILE_PATTERN_meta-kirkwood := "^${LAYERDIR}/"
BBFILE_PRIORITY_meta-kirkwood = "8"

#LAYERDEPENDS_meta-kirkwood = "core meta-python meta-arm"

LAYERSERIES_COMPAT_meta-kirkwood = "honister kirkstone langdale mickledore nanbield scarthgap"
```

## conf/machine/kirkwood.conf
```bitbake
#@TYPE: Machine
#@NAME: Kirkwood machine
#@DESCRIPTION: Machine configuration for kirkwood

TARGET_ARCH = "arm"

PREFERRED_PROVIDER_virtual/bootloader = ""
PREFERRED_PROVIDER_virtual/kernel = "linux-yocto"

IMAGE_FSTYPES += "tar.gz ubi"
SERIAL_CONSOLE = "115200 ttyS0"

KERNEL_IMAGETYPE = "uImage"
UBOOT_ENTRYPOINT = "0x00008000"
UBOOT_LOADADDRESS = "0x00008000"

require conf/machine/include/tune-arm926ejs.include
```
